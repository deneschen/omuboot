## configs/cubie_a7s_defconfig
```kconfig
CONFIG_ARM=y
CONFIG_ARM_SMCCC=y
CONFIG_ARCH_SUNXI=y
CONFIG_HAS_CUSTOM_SYS_INIT_SP_ADDR=y
CONFIG_CUSTOM_SYS_INIT_SP_ADDR=0x49f00000
CONFIG_DEFAULT_DEVICE_TREE="sun60i-a733-cubie-a7s"
CONFIG_MACH_SUN60I_A733=y
# CONFIG_VIDEO_SUNXI is not set
# CONFIG_SYS_MALLOC_CLEAR_ON_INIT is not set
CONFIG_ENV_IS_NOWHERE=y
CONFIG_SUPPORT_EMMC_BOOT=y
CONFIG_SYSRESET_PSCI=y
CONFIG_CMD_BOOTI=y
CONFIG_OF_BOARD_SETUP=y
```
